## CMakeLists.txt
```
cmake_minimum_required(VERSION 3.20.0)
find_package(Zephyr REQUIRED HINTS $ENV{ZEPHYR_BASE})

project(sl825)

target_sources(app PRIVATE src/main.c)

# Include source directory
target_include_directories(app PRIVATE src)
target_include_directories(app PRIVATE src/m_event)
target_include_directories(app PRIVATE src/m_ble)
target_include_directories(app PRIVATE src/common)

# Application directories
add_subdirectory(src/m_event)
add_subdirectory(src/m_ble)
add_subdirectory(src/common)

zephyr_library_include_directories(.)
```

## Kconfig
```
menu "Zephyr Kernel"
	source "Kconfig.zephyr"
endmenu

menu "TRAVEL Tracker"

config BT_NUS_THREAD_STACK_SIZE
	int "Thread stack size"
	default 1024
	help
	  Stack size used in each of the two threads

config BT_NUS_UART_BUFFER_SIZE
	int "UART payload buffer element size"
	default 40
	help
	  Size of the payload buffer in each RX and TX FIFO element

config BT_NUS_UART_RX_WAIT_TIME
	int "Timeout for UART RX complete event"
	default 50000
	help
	  Wait for RX complete event time in microseconds

	rsource "src/m_ble/Kconfig.ble"
	rsource "src/m_event/Kconfig.event_queue"
endmenu

module = APPLICATION
module-str = App
source "subsys/logging/Kconfig.template.log_config"
```

## prj.conf
```kconfig
#
# Copyright (c) 2018 Nordic Semiconductor
#
# SPDX-License-Identifier: LicenseRef-Nordic-5-Clause
#

# Enable the UART driver
CONFIG_UART_ASYNC_API=y
CONFIG_NRFX_UARTE0=y
CONFIG_SERIAL=y

CONFIG_GPIO=y

# Make sure printk is printing to the UART console
CONFIG_CONSOLE=y
CONFIG_UART_CONSOLE=y

CONFIG_HEAP_MEM_POOL_SIZE=2048

CONFIG_BT=y
CONFIG_BT_PERIPHERAL=y
CONFIG_BT_DEVICE_NAME="Hyunsung nRF52832"
CONFIG_BT_DEVICE_APPEARANCE=833
CONFIG_BT_MAX_CONN=1
CONFIG_BT_MAX_PAIRED=1

# Enable the NUS service
CONFIG_BT_NUS=y

# Enable bonding
CONFIG_BT_SETTINGS=y
CONFIG_FLASH=y
CONFIG_FLASH_PAGE_LAYOUT=y
CONFIG_FLASH_MAP=y
CONFIG_NVS=y
CONFIG_SETTINGS=y

# Enable DK LED and Buttons library
CONFIG_DK_LIBRARY=y

# This example requires more workqueue stack
CONFIG_SYSTEM_WORKQUEUE_STACK_SIZE=2048

# Config logger
CONFIG_LOG=y
CONFIG_USE_SEGGER_RTT=n
CONFIG_LOG_BACKEND_RTT=n
CONFIG_LOG_BACKEND_UART=y
CONFIG_LOG_PRINTK=n

CONFIG_ASSERT=y

CONFIG_CLOCK_CONTROL=y
CONFIG_CLOCK_CONTROL_NRF_K32SRC_500PPM=y
CONFIG_BLE_MODULE_LOG_LEVEL_DBG=y
CONFIG_APPLICATION_LOG_LEVEL_DBG=y
```

## prj_minimal.conf
```kconfig
#
# Copyright (c) 2021 Nordic Semiconductor
#
# SPDX-License-Identifier: LicenseRef-Nordic-5-Clause
#

# Enable the UART driver
CONFIG_UART_ASYNC_API=y
CONFIG_NRFX_UARTE0=y
CONFIG_SERIAL=y

CONFIG_HEAP_MEM_POOL_SIZE=2048

CONFIG_BT=y
CONFIG_BT_PERIPHERAL=y
CONFIG_BT_DEVICE_NAME="Hyunsung nRF52832"
CONFIG_BT_DEVICE_APPEARANCE=833
CONFIG_BT_MAX_CONN=1
CONFIG_BT_MAX_PAIRED=1

# Enable the NUS service
CONFIG_BT_NUS=y

# Enable bonding
CONFIG_BT_SETTINGS=y
CONFIG_FLASH=y
CONFIG_FLASH_PAGE_LAYOUT=y
CONFIG_FLASH_MAP=y
CONFIG_NVS=y
CONFIG_SETTINGS=y

# Enable DK LED and Buttons library
CONFIG_DK_LIBRARY=y

# Drivers and peripherals
# CONFIG_I2C=n
# CONFIG_WATCHDOG=n
# CONFIG_SPI=n

# Power management
# CONFIG_PM=n

# Interrupts
# CONFIG_DYNAMIC_INTERRUPTS=n
# CONFIG_IRQ_OFFLOAD=n

# Memory protection
# CONFIG_THREAD_STACK_INFO=n
# CONFIG_THREAD_CUSTOM_DATA=n
# CONFIG_FPU=n

# Boot
CONFIG_BOOT_BANNER=y
CONFIG_BOOT_DELAY=10

# Console
CONFIG_CONSOLE=y
CONFIG_UART_CONSOLE=y
CONFIG_STDOUT_CONSOLE=y
CONFIG_PRINTK=y
CONFIG_EARLY_CONSOLE=y
CONFIG_LOG_BACKEND_UART=y
# Build
# CONFIG_SIZE_OPTIMIZATIONS=y

# ARM
CONFIG_ARM_MPU=n

# In order to correctly tune the stack sizes for the threads the following
# Configurations can enabled to print the current use:
#CONFIG_THREAD_NAME=y
#CONFIG_THREAD_ANALYZER=y
#CONFIG_THREAD_ANALYZER_AUTO=y
#CONFIG_THREAD_ANALYZER_RUN_UNLOCKED=y
#CONFIG_THREAD_ANALYZER_USE_PRINTK=y
#CONFIG_CONSOLE=y
#CONFIG_UART_CONSOLE=y
#CONFIG_SERIAL=y
#CONFIG_PRINTK=y

# Example output of thread analyzer
#SDC RX              : unused 800 usage 224 / 1024 (21 %)
#BT ECC              : unused 216 usage 888 / 1104 (80 %)
#BT RX               : unused 1736 usage 464 / 2200 (21 %)
#BT TX               : unused 1008 usage 528 / 1536 (34 %)
#ble_write_thread_id : unused 688 usage 336 / 1024 (32 %)
#sysworkq            : unused 1912 usage 136 / 2048 (6 %)
#MPSL signal         : unused 928 usage 96 / 1024 (9 %)
#idle 00             : unused 224 usage 96 / 320 (30 %)
#main                : unused 568 usage 456 / 1024 (44 %)
# CONFIG_BT_RX_STACK_SIZE=1024
# CONFIG_BT_HCI_TX_STACK_SIZE_WITH_PROMPT=y
# CONFIG_BT_HCI_TX_STACK_SIZE=640
CONFIG_SYSTEM_WORKQUEUE_STACK_SIZE=2048
# CONFIG_MPSL_WORK_STACK_SIZE=256
# CONFIG_MAIN_STACK_SIZE=640
# CONFIG_IDLE_STACK_SIZE=128
# CONFIG_ISR_STACK_SIZE=1024
CONFIG_BT_NUS_THREAD_STACK_SIZE=512

# Disable features not needed
# CONFIG_TIMESLICING=n
# CONFIG_MINIMAL_LIBC_MALLOC=n
CONFIG_LOG=y
CONFIG_ASSERT=y

# Disable Bluetooth features not needed
# CONFIG_BT_DEBUG_NONE=y
# CONFIG_BT_ASSERT=n
# CONFIG_BT_DATA_LEN_UPDATE=n
# CONFIG_BT_PHY_UPDATE=n
# CONFIG_BT_GATT_CACHING=n
# CONFIG_BT_GATT_SERVICE_CHANGED=n
# CONFIG_BT_GAP_PERIPHERAL_PREF_PARAMS=n
# CONFIG_BT_SETTINGS_CCC_LAZY_LOADING=y
# CONFIG_BT_HCI_VS_EXT=n

# Disable Bluetooth controller features not needed
# CONFIG_BT_CTLR_PRIVACY=n
# CONFIG_BT_CTLR_PHY_2M=n

# Reduce Bluetooth buffers
# CONFIG_BT_BUF_EVT_DISCARDABLE_COUNT=1
# CONFIG_BT_BUF_EVT_DISCARDABLE_SIZE=43
# CONFIG_BT_BUF_EVT_RX_COUNT=2

CONFIG_BT_CONN_TX_MAX=2
CONFIG_BT_L2CAP_TX_BUF_COUNT=2
# CONFIG_BT_CTLR_RX_BUFFERS=1
# CONFIG_BT_BUF_ACL_TX_COUNT=3
# CONFIG_BT_BUF_ACL_TX_SIZE=27

CONFIG_CLOCK_CONTROL=y
CONFIG_CLOCK_CONTROL_NRF_K32SRC_500PPM=y
```

## src/main.c
```c
/*
 * Copyright (c) 2018 Nordic Semiconductor ASA
 *
 * SPDX-License-Identifier: LicenseRef-Nordic-5-Clause
 */

/** @file
 *  @brief Nordic UART Bridge Service (NUS) sample
 */
#include <zephyr/types.h>
#include <zephyr/kernel.h>

#include <zephyr/device.h>
#include <zephyr/devicetree.h>
#include <soc.h>

#include <dk_buttons_and_leds.h>

#include <zephyr/settings/settings.h>

#include <stdio.h>

#include <zephyr/logging/log.h>

#include "compile_date.h"
#include "m_event_queue.h"
#include "m_ble.h"

#define LOG_MODULE_NAME main
LOG_MODULE_REGISTER(LOG_MODULE_NAME, CONFIG_APPLICATION_LOG_LEVEL);

static void banner(void)
{
	LOG_INF("==================================================");
	LOG_INF("\tHyunSung TravelTracker");
	LOG_INF("\tBuild Date : %04d-%02d-%02d %02d:%02d:%02d", 
			BUILD_YEAR, BUILD_MONTH, BUILD_DAY, 
			BUILD_HOUR, BUILD_MIN, BUILD_SEC);
	LOG_INF("==================================================");			
}

static void configure_gpio(void)
{
	int err;

	err = dk_leds_init();
	if (err) {
		LOG_ERR("Cannot init LEDs (err: %d)", err);
	}
}

static int init_device(void)
{
	int err = 0;

	do{
		err = m_ble_init();
		if(err){
			LOG_ERR("Ble init error!!");
			break;
		}
	}while(0);

	return err;
}

int main(void)
{
	int err;

	configure_gpio();
	banner();	
	err = init_device();
	if(err){
		printk("init error!!\r\n");
		return -1;
	}

	for (;;) {
		m_event_dispatch();
	}
}
```
